## conf/layer.conf
```bitbake
# We have a conf and classes directory, add to BBPATH
BBPATH .= ":${LAYERDIR}"

# We have recipes-* directories, add to BBFILES
BBFILES += "${LAYERDIR}/recipes-*/*/*.bb \
            ${LAYERDIR}/recipes-*/*/*.bbappend"

BBFILE_COLLECTIONS += "meta-odroid"
BBFILE_PATTERN_meta-odroid = "^${LAYERDIR}/"
BBFILE_PRIORITY_meta-odroid = "6"

LAYERDEPENDS_meta-odroid = "core"
LAYERSERIES_COMPAT_meta-odroid = "nanbield"
```

## conf/machine/odroid-xu4.conf
```bitbake
#@TYPE: Machine
#@NAME: odroid-xu4
#@DESCRIPTION: Machine configuration for odroid-xu4 systems
#@MAINTAINER: Gustavo Branco <guster32@gmail.com>

include conf/machine/include/odroid-xu-default.inc

TCLIBC = "glibc"
UBOOT_ENV_SUFFIX = "scr"
MACHINE_FEATURES_append = " emmc mali"
KERNEL_DEVICETREE ?= "exynos5422-odroidxu4.dtb"
UBOOT_MACHINE_odroid-xu4 = "odroid-xu4_defconfig"
```
